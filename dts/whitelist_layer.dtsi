/*
 * Copyright (c) 2024 The ZMK Contributors
 * SPDX-License-Identifier: MIT
 */

/ {
    behaviors {
        /omit-if-no-ref/
        wlmo: whitelist_layer {
            compatible = "zmk,behavior-whitelist-layer";
            #binding-cells = <1>;
            display-name = "Whitelist Momentary Layer";
        };
    };
};
