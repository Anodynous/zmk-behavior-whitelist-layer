## Kconfig
```kconfig
# Copyright (c) 2024 The ZMK Contributors
# SPDX-License-Identifier: MIT

DT_COMPAT_ZMK_BEHAVIOR_WHITELIST_LAYER := zmk,behavior-whitelist-layer

config ZMK_BEHAVIOR_WHITELIST_LAYER
    bool
    default $(dt_compat_enabled,$(DT_COMPAT_ZMK_BEHAVIOR_WHITELIST_LAYER))
```

## dts/bindings/zmk,behavior-whitelist-layer.yaml
```yaml
# Copyright (c) 2024 The ZMK Contributors
# SPDX-License-Identifier: MIT

description: Whitelist-aware momentary layer behavior

compatible: "zmk,behavior-whitelist-layer"

include: one_param.yaml

properties:
  display-name:
    type: string
```
